## configs/qcom_qcs8550_defconfig
```kconfig
# Configuration for building U-Boot to be flashed
# to the uefi partition of SM8550 dev boards with
# the "Linux Embedded" partition layout (which have
# a dedicated "uefi_a" partition for edk2/U-Boot)

#include "qcom_defconfig"

# Otherwise buildman thinks this isn't an ARM platform
CONFIG_ARM=y
CONFIG_DEBUG_UART=y
CONFIG_DEBUG_UART_ANNOUNCE=y
CONFIG_DEBUG_UART_BASE=0xa9c000
CONFIG_DEBUG_UART_MSM_GENI=y
CONFIG_DEBUG_UART_CLOCK=14745600

# Address where U-Boot will be loaded
CONFIG_TEXT_BASE=0xaf000000
CONFIG_REMAKE_ELF=y

CONFIG_DEFAULT_DEVICE_TREE="qcom/sm8550-hdk"
CONFIG_OF_EMBED=y

CONFIG_BOOTDELAY=5
CONFIG_LOG_MAX_LEVEL=9
CONFIG_LOG_DEFAULT_LEVEL=3
CONFIG_LOGLEVEL=3

CONFIG_PINCTRL_QCOM=y
CONFIG_PINCTRL_QCOM_SM8550=y
CONFIG_SYS_I2C_GENI=y

CONFIG_QCOM_SMEM=y
CONFIG_QCOM_RPMH=y
CONFIG_QCOM_POWER_DOMAIN=y


CONFIG_UFS=y
CONFIG_UFS_QCOM=y
CONFIG_CMD_UFS=y
CONFIG_SCSI=y
CONFIG_SCSI_UFS=y
CONFIG_DM_SCSI=y
CONFIG_MMC=y
CONFIG_MMC_SDHCI=y
CONFIG_MMC_SDHCI_MSM=y
CONFIG_CMD_MMC=y
# VM3 memory base from UEFI: 0x80000000
CONFIG_SYS_SDRAM_BASE=0x80000000
# Place U-Boot text low in the first region
CONFIG_SYS_TEXT_BASE=0x80080000
# Load address for images (inside VM3 IPA window)
CONFIG_SYS_LOAD_ADDR=0x88000000
CONFIG_SYS_MALLOC_LEN=0x02000000
CONFIG_ARM_PMU=y
CONFIG_ARM_CCI_PMU=y

CONFIG_SPL_ARM_PSCI_FW=y
CONFIG_ARM_PSCI_FW=y
CONFIG_USB_DWC3=y
CONFIG_USB_DWC3_GENERIC=y



CONFIG_HUSH_MODERN_PARSER=y
CONFIG_CMD_BOOTMENU=y
CONFIG_CMD_NVEDIT_EFI=y
CONFIG_CMD_EEPROM=y
CONFIG_SYS_I2C_EEPROM_BUS=2
CONFIG_SYS_I2C_EEPROM_ADDR_LEN=2
CONFIG_SYS_EEPROM_PAGE_WRITE_BITS=5
CONFIG_CMD_CLK=y
CONFIG_CMD_DFU=y
CONFIG_CMD_GPIO=y
CONFIG_CMD_GPT=y
CONFIG_CMD_GPT_RENAME=y
CONFIG_CMD_I2C=y
CONFIG_CMD_LOADM=y
CONFIG_CMD_MMC=y
CONFIG_CMD_UFS=y
CONFIG_CMD_USB=y
CONFIG_CMD_USB_MASS_STORAGE=y
CONFIG_CMD_UMS_ABORT_KEYED=y
CONFIG_CMD_CAT=y
CONFIG_BOOTP_MAY_FAIL=y
CONFIG_CMD_BMP=y
CONFIG_CMD_EFIDEBUG=y
CONFIG_CMD_REGULATOR=y
CONFIG_CMD_EXT4_WRITE=y
CONFIG_CMD_LOG=y
CONFIG_PARTITION_TYPE_GUID=y
CONFIG_OF_LIVE=y
CONFIG_OF_UPSTREAM_BUILD_VENDOR=y
CONFIG_USE_DEFAULT_ENV_FILE=y
CONFIG_DEFAULT_ENV_FILE="board/qualcomm/ayn.env"
CONFIG_PROT_TCP_SACK=y
CONFIG_BUTTON_REMAP_PHONE_KEYS=y
CONFIG_BUTTON_QCOM_PMIC=y
CONFIG_CLK=y
CONFIG_CLK_QCOM_APQ8016=y
CONFIG_CLK_QCOM_APQ8096=y
CONFIG_CLK_QCOM_QCM2290=y
CONFIG_CLK_QCOM_QCS404=y
CONFIG_CLK_QCOM_SDM845=y
CONFIG_CLK_QCOM_SM6115=y
CONFIG_CLK_QCOM_SM8150=y
CONFIG_CLK_QCOM_SM8250=y
CONFIG_CLK_QCOM_SM8550=y
CONFIG_CLK_QCOM_SM8650=y
CONFIG_CLK_QCOM_SC7280=y
CONFIG_CLK_STUB=y
CONFIG_DFU_MMC=y
CONFIG_DFU_SCSI=y
CONFIG_SYS_DFU_DATA_BUF_SIZE=0x200000
CONFIG_MSM_GPIO=y
CONFIG_QCOM_PMIC_GPIO=y
CONFIG_DM_I2C=y
CONFIG_SYS_I2C_QUP=y
CONFIG_SYS_I2C_GENI=y
CONFIG_I2C_MUX=y
CONFIG_DM_KEYBOARD=y
CONFIG_BUTTON_KEYBOARD=y
CONFIG_IOMMU=y
CONFIG_QCOM_HYP_SMMU=y
CONFIG_MISC=y
CONFIG_NVMEM=y
CONFIG_I2C_EEPROM=y
CONFIG_MMC_HS200_SUPPORT=y
CONFIG_MMC_SDHCI=y
CONFIG_MMC_SDHCI_ADMA=y
CONFIG_MMC_SDHCI_MSM=y
CONFIG_PHY_MICREL=y
CONFIG_PHY_MICREL_KSZ90X1=y
CONFIG_DM_MDIO=y
CONFIG_DM_ETH_PHY=y
CONFIG_DWC_ETH_QOS=y
CONFIG_DWC_ETH_QOS_QCOM=y
CONFIG_RGMII=y
CONFIG_PHY=y
CONFIG_PHY_QCOM_QMP=y
CONFIG_PHY_QCOM_QMP_UFS=y
CONFIG_PHY_QCOM_QUSB2=y
CONFIG_PHY_QCOM_USB_SNPS_FEMTO_V2=y
CONFIG_PHY_QCOM_SNPS_EUSB2=y
CONFIG_PINCTRL=y
CONFIG_PINCONF=y
CONFIG_PINCTRL_QCOM_APQ8016=y
CONFIG_PINCTRL_QCOM_APQ8096=y
CONFIG_PINCTRL_QCOM_QCM2290=y
CONFIG_PINCTRL_QCOM_QCS404=y
CONFIG_PINCTRL_QCOM_SDM845=y
CONFIG_PINCTRL_QCOM_SM6115=y
CONFIG_PINCTRL_QCOM_SM8150=y
CONFIG_PINCTRL_QCOM_SM8250=y
CONFIG_PINCTRL_QCOM_SM8550=y
CONFIG_PINCTRL_QCOM_SM8650=y
CONFIG_DM_PMIC=y
CONFIG_PMIC_QCOM=y
CONFIG_DM_REGULATOR=y
CONFIG_DM_REGULATOR_FIXED=y
CONFIG_DM_REGULATOR_GPIO=y
CONFIG_DM_REGULATOR_QCOM_RPMH=y
CONFIG_DM_RTC=y
CONFIG_RTC_EMULATION=y
CONFIG_SCSI=y
CONFIG_MSM_SERIAL=y
CONFIG_MSM_GENI_SERIAL=y
CONFIG_SOC_QCOM=y
CONFIG_QCOM_COMMAND_DB=y
CONFIG_QCOM_RPMH=y
CONFIG_QCOM_SMEM=y
CONFIG_SPMI_MSM=y
CONFIG_SYSINFO=y
CONFIG_SYSINFO_SMBIOS=y
CONFIG_USB=y
CONFIG_DM_USB_GADGET=y
CONFIG_USB_XHCI_HCD=y
CONFIG_USB_XHCI_DWC3=y
CONFIG_USB_DWC3=y
CONFIG_USB_DWC3_GENERIC=y
CONFIG_USB_HOST_ETHER=y
CONFIG_USB_ETHER_ASIX88179=y
CONFIG_USB_GADGET=y
CONFIG_USB_GADGET_DOWNLOAD=y

CONFIG_USB_GADGET_VENDOR_NUM=0x17CB
CONFIG_USB_GADGET_PRODUCT_NUM=0xd00d
CONFIG_USB_GADGET_VENDOR_NUM=0x18d1
CONFIG_USB_GADGET_PRODUCT_NUM=0x4ee0
CONFIG_USB_GADGET_MANUFACTURER="Qualcomm"
CONFIG_USB_GADGET_PRODUCT="Fastboot"
CONFIG_USB_DWC3=y
CONFIG_USB_DWC3_GADGET=y
CONFIG_USB_GADGET_DWC3=y
CONFIG_FASTBOOT_FLASH_UFS=y
CONFIG_USB_FUNCTION_ACM=y
CONFIG_UFS=y
CONFIG_QCOM_UFS=y
CONFIG_VIDEO=y
CONFIG_VIDEO_FONT_16X32=y
CONFIG_SYS_WHITE_ON_BLACK=y
CONFIG_NO_FB_CLEAR=y
CONFIG_VIDEO_SIMPLE=y
CONFIG_HEXDUMP=y
CONFIG_EFI_RT_VOLATILE_STORE=y
CONFIG_EFI_SET_TIME=y
CONFIG_EFI_RUNTIME_UPDATE_CAPSULE=y
CONFIG_EFI_CAPSULE_ON_DISK=y
CONFIG_EFI_IGNORE_OSINDICATIONS=y
CONFIG_EFI_CAPSULE_FIRMWARE_RAW=y
CONFIG_SYMBOL_LOOKUP=y
CONFIG_EFI_HTTP_BOOT=y

CONFIG_USB_FUNCTION_FASTBOOT=y

CONFIG_USB=y
CONFIG_USB_GADGET=y
CONFIG_USB_GADGET_DOWNLOAD=y
CONFIG_FASTBOOT=y
CONFIG_FASTBOOT_FLASH=y
CONFIG_FASTBOOT_FLASH_MMC=y        # if flashing eMMC/UFS via mmc
CONFIG_FASTBOOT_FLASH_NAND=y       # if flashing NAND
CONFIG_FASTBOOT_BUF_ADDR=0x90000000
CONFIG_FASTBOOT_BUF_SIZE=0x20000000


CONFIG_GCC_UFS_MEM_CLKREF_CLK=y
CONFIG_GCC_UFS_MEM_AXI_CLK=y
CONFIG_GCC_UFS_MEM_AHB_CLK=y
CONFIG_GCC_UFS_MEM_ICE_CORE_CLK=y

CONFIG_FS_EXT4=y 
CONFIG_PARTITIONS=y
```
